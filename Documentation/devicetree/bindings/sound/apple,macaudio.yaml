## Documentation/devicetree/bindings/sound/apple,macaudio.yaml
```yaml
# SPDX-License-Identifier: (GPL-2.0-only OR BSD-2-Clause)
%YAML 1.2
---
$id: http://devicetree.org/schemas/sound/apple,macaudio.yaml#
$schema: http://devicetree.org/meta-schemas/core.yaml#

title: Sound peripheral integration for Apple Silicon Macs

description:
  This binding represents the overall machine-level integration of sound
  peripherals on Apple Silicon Macs, starting with the M1 series.

maintainers:
  - James Calligeros <jcalligeros99@gmail.com>

properties:
  compatible:
    oneOf:
      - items:
          - enum:
              - apple,j180-macaudio
              - apple,j274-macaudio
              - apple,j293-macaudio
              - apple,j313-macaudio
              - apple,j314-macaudio
              - apple,j316-macaudio
              - apple,j375-macaudio
              - apple,j413-macaudio
              - apple,j415-macaudio
              - apple,j473-macaudio
              - apple,j456-macaudio
              - apple,j457-macaudio
      - items:
          - enum:
              - apple,j493-macaudio
          - const: apple,j293-macaudio
      - items:
          - enum:
              - apple,j414-macaudio
              - apple,j504-macaudio
              - apple,j514-macaudio
          - const: apple,j314-macaudio
      - items:
          - enum:
              - apple,j416-macaudio
              - apple,j516-macaudio
          - const: apple,j316-macaudio
      - items:
          - enum:
              - apple,j475-macaudio
              - apple,j575-macaudio
          - const: apple,j375-macaudio
      - items:
          - enum:
              - apple,j613-macaudio
          - const: apple,j413-macaudio
      - items:
          - enum:
              - apple,j615-macaudio
          - const: apple,j415-macaudio
      - items:
          - enum:
              - apple,j474-macaudio
          - const: apple,j473-macaudio

  "#address-cells":
    const: 1

  "#size-cells":
    const: 0

  model:
    description:
      Model name for presentation to users
    $ref: /schemas/types.yaml#/definitions/string

patternProperties:
  "^dai-link(@[0-9a-f]+)?$":
    description: |
      Node for each sound peripheral such as the speaker array, headphones jack,
      or microphone.
    type: object
    $ref: tdm-slot.yaml#

    additionalProperties: false

    properties:
      reg:
        maxItems: 1

      link-name:
        description: Name for the peripheral
        enum: [ Headphones Jack, Speaker, Speakers ]
        $ref: /schemas/types.yaml#/definitions/string

      codec:
        type: object

        additionalProperties: false

        properties:
          sound-dai:
            minItems: 1
            maxItems: 8
            description: |
              DAI list with the CODEC-side DAIs connected to the above CPU-side
              DAIs and involved in this sound peripheral.

              The list is in left/right order if applicable. If there are more
              than one CPU-side DAIs (there can be two), the CODECs must be
              listed first those connected to the first CPU, then those
              connected to the second.

              In addition, on some machines with many speaker codecs, the CODECs
              are listed in this fixed order:

              Four speakers: Left Front, Left Rear, Right Front, Right Rear
              Six speakers: Left Woofer 1, Left Tweeter, Left Woofer 2,
                            Right Woofer 1, Right Tweeter, Right Woofer 2

        required:
          - sound-dai

      cpu:
        type: object

        additionalProperties: false

        properties:
          sound-dai:
            minItems: 1
            maxItems: 2
            description: |
              DAI list with CPU-side I2S ports involved in this peripheral.

        required:
          - sound-dai

    patternProperties:
      "^dai-tdm-idle-mode-[0-9]$":
        $ref: tdm-slot.yaml#/properties/dai-tdm-idle-mode

      "^dai-tdm-slot-tx-idle-mask-[0-9]$":
        $ref: /schemas/types.yaml#/definitions/uint32
        description: Idle slot mask. A bit being set to 1 indicates
          that the corresponding TDM slot is inactive/idle.

    required:
      - reg
      - codec
      - cpu

required:
  - compatible
  - model

additionalProperties: false

examples:
  - |
    sound {
      compatible = "apple,j416-macaudio", "apple,j316-macaudio";
      model = "MacBook Pro J416";

      #address-cells = <1>;
      #size-cells = <0>;

      dai-link@0 {
        reg = <0>;
        link-name = "Speakers";

        dai-tdm-idle-mode-0 = "zero";
        dai-tdm-idle-mode-3 = "zero";
        dai-tdm-slot-tx-idle-mask-0 = <0xf0f0f0>;
        dai-tdm-slot-tx-idle-mask-3 = <0x0f0f0f>;

        codec {
          sound-dai = <&speaker_left_woof1>,
                      <&speaker_left_tweet>,
                      <&speaker_left_woof2>,
                      <&speaker_right_woof1>,
                      <&speaker_right_tweet>,
                      <&speaker_right_woof2>;
        };

        cpu {
          sound-dai = <&mca 0>, <&mca 1>;
        };
      };

      dai-link@1 {
        reg = <1>;
        link-name = "Headphones Jack";

        codec {
          sound-dai = <&jack_codec>;
        };

        cpu {
          sound-dai = <&mca 2>;
        };
      };
    };
```
